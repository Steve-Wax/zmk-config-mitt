## config/boards/shields/mitt/Kconfig.defconfig
```kconfig
# Copyright (c) 2020 The ZMK Contributors
# SPDX-License-Identifier: MIT

if SHIELD_MITT_LEFT

config ZMK_KEYBOARD_NAME
	default "Mitt Keyboard"

config ZMK_SPLIT_BLE_ROLE_CENTRAL
	default y

endif

if SHIELD_MITT_LEFT || SHIELD_MITT_RIGHT

config ZMK_SPLIT
	default y

endif
```

## config/boards/shields/mitt/Kconfig.shield
```kconfig
# Copyright (c) 2020 The ZMK Contributors
# SPDX-License-Identifier: MIT

config SHIELD_MITT_LEFT
	def_bool $(shields_list_contains,mitt_left)

config SHIELD_MITT_RIGHT
	def_bool $(shields_list_contains,mitt_right)
```
